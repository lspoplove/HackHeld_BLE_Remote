#pragma once
#include <Arduino.h>
// Generated by tools/embed_web.py; no CDN or external dependencies.
static const char WEB_HTML[] PROGMEM = R"HHRWEB(<!doctype html>
<html lang="en">
<head>
<meta charset="utf-8"><meta name="viewport" content="width=device-width,initial-scale=1">
<meta name="color-scheme" content="dark light">
<title>DSTIKE Remote · Key Setup</title>
<link rel="stylesheet" href="/app.css"><script src="/app.js" defer></script>
</head>
<body>
<main>
<header><div><div class="eyebrow">DSTIKE / HACKHELD</div><h1>Make every key yours.</h1><p class="subtitle">On-device key setup · BLE Remote v3</p></div><span class="badge">LOCAL SETUP</span></header>
<section class="notice"><strong>Bluetooth controls are paused.</strong> Save your changes, then exit setup and choose Phone or Computer on the remote. This Wi-Fi network does not provide Internet access.</section>
<div class="toolbar"><label for="profile">Control profile<select id="profile" disabled><option value="0">Phone · Media</option><option value="1">Computer · Presentation</option><option value="2">Computer · Media</option></select></label><div><div id="storage" class="muted">Connecting to your device…</div><div id="dirty" class="dirty">No unsaved changes</div></div></div>
<p id="message" class="message" role="status" aria-live="polite">Loading configuration…</p>
<form id="editor"><fieldset id="fields" disabled><div id="keys" class="grid"></div></fieldset>
<div class="actions"><button id="save" class="primary" type="submit" disabled>Save this profile</button><button id="reload" type="button">Reload from device</button><button id="reset" type="button" disabled>Reset this profile</button></div></form>
<section class="help"><h2>How key mapping works</h2><p><strong>Keyboard:</strong> one key plus optional Ctrl, Shift, Alt or Win/Cmd. Actions depend on the focused app and its shortcuts.</p><p><strong>Media:</strong> playback, volume and track controls. Phone mute depends on the phone and player; it is not the ringer or Do Not Disturb switch.</p><p><strong>Labels:</strong> 1–12 printable English/ASCII characters. The OLED overview shows the first 10. This is a name, not text to type.</p><p><strong>Repeat:</strong> available on direction buttons only. A and B fire on release; holding A+B for 1.2 seconds remains the Back gesture and cannot be reassigned.</p><p>Saving affects only the selected profile. No macros, scripts, firmware uploads or browser-triggered key presses are provided. Setup closes after 10 minutes without a page request; unsaved browser edits are not stored.</p></section>
<footer><button id="resetAll" class="danger" disabled>Restore all three profiles</button><button id="exit" disabled>Exit setup</button><p>Press B on the remote to exit at any time. Wi-Fi turns off; saved mappings stay on the device.</p></footer>
<noscript>This page needs JavaScript. It does not download any Internet libraries.</noscript>
</main>
</body>
</html>
)HHRWEB";
static const char WEB_CSS[] PROGMEM = R"HHRWEB(:root{color-scheme:dark;--bg:#0e1319;--panel:#182029;--line:#2d3946;--text:#f0f4f8;--muted:#a7b6c6;--accent:#80edc0;--danger:#ffb7b0}*{box-sizing:border-box}body{margin:0;background:var(--bg);color:var(--text);font-family:system-ui,-apple-system,"Segoe UI",sans-serif;font-size:15px;line-height:1.5}main{max-width:1120px;margin:0 auto;padding:40px 24px}header{display:flex;justify-content:space-between;align-items:flex-start;gap:20px;margin-bottom:26px}.eyebrow{font-size:12px;letter-spacing:2px;color:var(--accent);font-weight:700}h1{font-size:clamp(28px,4vw,40px);letter-spacing:-1px;line-height:1.15;margin:10px 0}.subtitle,.muted,footer p{color:var(--muted);margin:0}.badge{white-space:nowrap;border:1px solid var(--line);border-radius:100px;padding:7px 12px;font-size:10px;letter-spacing:1px;margin-top:6px}.notice{border:1px solid #355749;border-radius:12px;padding:16px 18px;background:#172820;color:#d0f2e2}.toolbar{display:flex;justify-content:space-between;align-items:center;gap:20px;margin:28px 0 12px}.toolbar>label{width:360px;max-width:100%}label{display:block;font-size:12px;font-weight:600;letter-spacing:.2px;color:var(--muted)}select,input[type=text]{display:block;width:100%;min-height:42px;margin-top:7px;padding:9px 11px;background:#10171f;border:1px solid var(--line);border-radius:8px;color:var(--text);font:inherit;font-size:14px;letter-spacing:0}button{min-height:43px;padding:10px 16px;border:1px solid var(--line);border-radius:8px;background:var(--panel);color:var(--text);font:inherit;font-size:14px;cursor:pointer}button:hover:not(:disabled){border-color:var(--accent)}button.primary{background:var(--accent);color:#08271a;font-weight:750;border-color:var(--accent)}button.danger{color:var(--danger)}button:disabled,select:disabled,input:disabled{opacity:.45;cursor:not-allowed}button:focus-visible,input:focus-visible,select:focus-visible{outline:2px solid var(--accent);outline-offset:3px}.dirty{font-size:12px;margin-top:4px;color:var(--muted)}.dirty.changed{color:var(--accent)}.message{min-height:26px;color:var(--muted);margin:12px 0}.message.error{color:var(--danger)}.message.success{color:var(--accent)}fieldset{border:0;padding:0;margin:0;min-width:0}.grid{display:grid;grid-template-columns:repeat(3,minmax(0,1fr));gap:16px}.card{background:var(--panel);border:1px solid var(--line);border-radius:12px;padding:18px;min-width:0}.card-top{display:flex;align-items:center;gap:12px;margin-bottom:18px}.keycap{display:grid;place-items:center;width:38px;height:38px;background:#111820;border:1px solid #425364;border-bottom-width:3px;border-radius:8px;font-size:18px;font-weight:700}.card h2{font-size:16px;line-height:1.2;margin:0}.card .sub{font-size:11px;color:var(--muted);margin-top:4px}.card>label{margin-bottom:12px}.modifiers{display:flex;flex-wrap:wrap;gap:8px;margin:12px 0}.check{display:flex;align-items:center;gap:5px;font-size:12px;color:var(--text);font-weight:400;letter-spacing:0}.check input{accent-color:var(--accent);width:16px;height:16px;margin:0}.repeat{margin-top:14px}.actions{display:flex;flex-wrap:wrap;gap:10px;margin:22px 0 30px}.help{border-top:1px solid var(--line);padding-top:20px;color:var(--muted);font-size:13px}.help h2{color:var(--text);font-size:17px}.help p{margin:9px 0}.help strong{color:var(--text)}footer{border-top:1px solid var(--line);margin-top:28px;padding-top:20px;display:flex;flex-wrap:wrap;gap:10px}footer p{flex-basis:100%;font-size:12px;margin-top:6px}@media(max-width:850px){.grid{grid-template-columns:repeat(2,minmax(0,1fr))}}@media(max-width:560px){main{padding:24px 16px}header{display:block}.badge{display:inline-block;margin-top:12px}.toolbar{display:block}.toolbar>div{margin-top:14px}.grid{grid-template-columns:1fr}.card{padding:18px}.actions button{flex:1 1 45%}h1{letter-spacing:-.6px}}
)HHRWEB";
static const char WEB_JS[] PROGMEM = R"HHRWEB('use strict';
(() => {
  const $ = id => document.getElementById(id);
  const buttons = ['Up', 'Down', 'Left', 'Right', 'A', 'B'];
  const symbols = ['↑', '↓', '←', '→', 'A', 'B'];
  let state = null, catalog = null, draft = [], selected = 0;
  let changed = false, busy = false, exited = false, rendering = false;
  const clone = obj => JSON.parse(JSON.stringify(obj));
  function message(text, style = '') { $('message').textContent = text; $('message').className = 'message ' + style; }
  function controls() {
    const blocked = busy || !state || !catalog || exited;
    for (const id of ['profile', 'fields', 'save', 'reset', 'resetAll', 'exit']) $(id).disabled = blocked;
    $('reload').disabled = busy || exited;
    $('dirty').textContent = changed ? 'Unsaved changes in this profile' : 'No unsaved changes';
    $('dirty').className = 'dirty' + (changed ? ' changed' : '');
  }
  async function request(path, form) {
    const controller = new AbortController();
    const timer = setTimeout(() => controller.abort(), 12000);
    try {
      const opts = {cache: 'no-store', signal: controller.signal};
      if (form !== undefined) {
        opts.method = 'POST'; opts.headers = {'Content-Type': 'application/x-www-form-urlencoded', 'X-Setup-Token': state.token};
        opts.body = form.toString();
      }
      const response = await fetch(path, opts);
      let data;
      try { data = await response.json(); } catch (_) { throw new Error('Unexpected response. Stay connected to the setup Wi-Fi and open http://192.168.4.1.'); }
      if (!response.ok) throw new Error(data.error || 'Device request failed.');
      return data;
    } finally { clearTimeout(timer); }
  }
  function validateState(value) {
    if (!value || value.version !== 3 || !Array.isArray(value.profiles) || value.profiles.length !== 3 ||
        typeof value.token !== 'string' || !Number.isInteger(value.revision) ||
        value.profiles.some(p => !Array.isArray(p.actions) || p.actions.length !== 6))
      throw new Error('Unexpected firmware configuration. Check that the device runs v3.');
    return value;
  }
  function option(select, value, text) { const el = document.createElement('option'); el.value = value; el.textContent = text; select.append(el); }
  function commandOptions(select, action) {
    select.replaceChildren();
    const choices = action.kind === 1 ? catalog.keyboard : action.kind === 2 ? catalog.media : [{usage: 0, name: 'No action'}];
    for (const key of choices) option(select, key.usage, key.name);
    select.value = String(action.usage); select.disabled = action.kind === 0;
  }
  function render() {
    // Removing a focused input can synchronously emit change/blur from the old
    // profile. Suppress those events before swapping the DOM and active draft.
    rendering = true;
    $('keys').replaceChildren();
    $('storage').textContent = state.storage;
    draft.forEach((action, index) => {
      const card = document.createElement('section'); card.className = 'card'; card.dataset.index = String(index);
      // Only constant markup enters innerHTML. User labels go through text/value properties.
      card.innerHTML = '<div class="card-top"><span class="keycap"></span><div><h2></h2><div class="sub"></div></div></div>' +
        '<label>Action type<select data-field="kind"></select></label><label>Command<select data-field="usage"></select></label>' +
        '<div class="modifiers"></div><label>OLED label<input data-field="label" type="text" maxlength="12" required autocomplete="off" spellcheck="false"></label>' +
        '<label class="check repeat"><input data-field="repeat" type="checkbox">Repeat while held</label>';
      card.querySelector('.keycap').textContent = symbols[index];
      card.querySelector('h2').textContent = buttons[index];
      card.querySelector('.sub').textContent = index < 4 ? 'Runs on press' : 'Runs on release · A+B reserved';
      const kind = card.querySelector('[data-field=kind]');
      option(kind, 2, 'Media control'); option(kind, 1, 'Keyboard shortcut'); option(kind, 0, 'Disabled'); kind.value = String(action.kind);
      kind.setAttribute('aria-label', buttons[index] + ' action type');
      const usage = card.querySelector('[data-field=usage]'); usage.setAttribute('aria-label', buttons[index] + ' command'); commandOptions(usage, action);
      const mods = card.querySelector('.modifiers');
      ['Ctrl', 'Shift', 'Alt', 'Win/Cmd'].forEach((name, bit) => {
        const lab = document.createElement('label'); lab.className = 'check';
        const check = document.createElement('input'); check.type = 'checkbox'; check.dataset.mod = String(1 << bit);
        check.checked = Boolean(action.modifiers & (1 << bit)); check.disabled = action.kind !== 1;
        check.setAttribute('aria-label', buttons[index] + ' ' + name); lab.append(check, document.createTextNode(name)); mods.append(lab);
      });
      const label = card.querySelector('[data-field=label]'); label.value = action.label; label.setAttribute('aria-label', buttons[index] + ' OLED label');
      const repeat = card.querySelector('[data-field=repeat]'); repeat.checked = Boolean(action.repeat); repeat.disabled = index >= 4 || action.kind === 0;
      repeat.setAttribute('aria-label', buttons[index] + ' repeat'); $('keys').append(card);
    });
    controls(); rendering = false;
  }
  function autoLabel(action) {
    if (action.kind === 0) return 'Disabled';
    const list = action.kind === 1 ? catalog.keyboard : catalog.media;
    const key = list.find(k => k.usage === action.usage);
    const mods = action.kind === 1 ? ['C+', 'S+', 'A+', 'G+'].filter((_, bit) => action.modifiers & (1 << bit)).join('') : '';
    return (mods + (key ? key.name : 'Key')).slice(0, 12);
  }
  function readCard(card) {
    const index = Number(card.dataset.index);
    const kind = Number(card.querySelector('[data-field=kind]').value);
    const action = {kind, usage: Number(card.querySelector('[data-field=usage]').value), modifiers: 0, repeat: 0,
      label: card.querySelector('[data-field=label]').value};
    if (kind === 1) for (const check of card.querySelectorAll('[data-mod]')) if (check.checked) action.modifiers |= Number(check.dataset.mod);
    if (kind !== 0 && index < 4 && card.querySelector('[data-field=repeat]').checked) action.repeat = 1;
    if (kind === 0) action.usage = 0;
    draft[index] = action; return action;
  }
  $('keys').addEventListener('change', event => {
    const card = event.target.closest('.card');
    if (rendering || !card || !$('keys').contains(card)) return;
    const index = Number(card.dataset.index);
    if (event.target.dataset.field === 'kind') {
      const kind = Number(event.target.value);
      draft[index] = {kind, usage: kind === 1 ? 40 : kind === 2 ? 205 : 0, modifiers: 0, repeat: 0, label: ''};
      draft[index].label = autoLabel(draft[index]); changed = true; render();
    } else {
      const action = readCard(card);
      if (event.target.dataset.field === 'usage' || event.target.dataset.mod) {
        action.label = autoLabel(action); card.querySelector('[data-field=label]').value = action.label;
      }
      changed = true; controls();
    }
  });
  $('keys').addEventListener('input', event => {
    if (rendering || !$('keys').contains(event.target)) return;
    if (event.target.dataset.field === 'label') { readCard(event.target.closest('.card')); changed = true; controls(); }
  });
  $('profile').addEventListener('change', () => {
    if (changed && !confirm('Discard unsaved changes in this profile?')) { $('profile').value = String(selected); return; }
    selected = Number($('profile').value); draft = clone(state.profiles[selected].actions); changed = false; render(); message('Editing ' + state.profiles[selected].name + '.');
  });
  async function load() {
    if (busy || exited) return;
    if (changed && !confirm('Discard unsaved changes and reload from the device?')) return;
    busy = true; controls(); message('Loading configuration…');
    try {
      const data = await request('/api/config');
      const choices = await request('/api/catalog');
      state = validateState(data); catalog = choices; draft = clone(state.profiles[selected].actions); changed = false;
      render(); message('Connected. Changes are stored only when you press Save.', 'success');
    } catch (error) { message(error.name === 'AbortError' ? 'Request timed out. Check the setup Wi-Fi and retry.' : error.message, 'error'); }
    finally { busy = false; controls(); }
  }
  async function write(path, form, success) {
    if (busy || exited) return;
    busy = true; controls(); message('Saving to the device…');
    try {
      state = validateState(await request(path, form)); draft = clone(state.profiles[selected].actions); changed = false;
      render(); message(success, 'success');
    } catch (error) {
      const text = error.name === 'AbortError' ? 'Request timed out.' : error.message;
      message(text + ' Save is not confirmed; reload to check the device before retrying.', 'error');
    } finally { busy = false; controls(); }
  }
  $('editor').addEventListener('submit', event => {
    event.preventDefault(); if (!state || busy || exited) return;
    for (const card of $('keys').querySelectorAll('.card')) readCard(card);
    if (draft.some(a => !/^[\x20-\x7e]{1,12}$/.test(a.label))) { message('Every label needs 1–12 printable English/ASCII characters.', 'error'); return; }
    const form = new URLSearchParams({profile: selected, revision: state.revision});
    draft.forEach((a, i) => { for (const field of ['kind', 'usage', 'modifiers', 'repeat', 'label']) form.set('b' + i + '_' + field, a[field]); form.set('b' + i + '_button', i); });
    write('/api/save', form, 'Saved on device. Exit setup to use this profile.');
  });
  $('reload').addEventListener('click', load);
  function reset(all) {
    if (!state || busy || exited || !confirm(all ? 'Restore and save factory defaults for ALL THREE profiles? This also discards unsaved edits.' : 'Restore and save factory defaults for this profile?')) return;
    write('/api/reset', new URLSearchParams({profile: all ? 3 : selected, revision: state.revision}), 'Factory defaults saved on device.');
  }
  $('reset').addEventListener('click', () => reset(false)); $('resetAll').addEventListener('click', () => reset(true));
  $('exit').addEventListener('click', async () => {
    if (!state || busy || exited || (changed && !confirm('Exit without saving these edits?'))) return;
    busy = true; controls();
    try { await request('/api/exit', new URLSearchParams()); exited = true; changed = false; message('Setup is closing. Choose Phone or Computer on your remote.', 'success'); }
    catch (error) { message('Exit was not confirmed. Press B on the remote to close setup.', 'error'); }
    finally { busy = false; controls(); }
  });
  window.addEventListener('beforeunload', event => { if (changed && !exited) { event.preventDefault(); event.returnValue = ''; } });
  load();
})();
)HHRWEB";
